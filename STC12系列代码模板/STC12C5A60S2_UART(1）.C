/*================================================================================================*/
/*  文件功能：UART-通用异步通信                                                                   */
/*  文件说明：无                                                                                  */
/*  硬件平台：STC12C5A60S2                                                                        */
/*  软件平台：Keil C51 uVision4                                                                   */
/*================================================================================================*/

//==============================包含的头文件========================================================
#include"main.h"                            // 包含全局头文件，
#include"STC12C5A60S2_UART.H"               // 包含内设头文件，UART-通用异步收发传输器

//==============================定义引用变量========================================================

//==============================宏自定义声明========================================================


//==================================================================================================
//  函数功能：UART 初始化
//  函数标记：应用函数，修改，添加晶振变化元素
//  函数说明：P3.0------接受端（RxD1）
//            P3.1------发送端（TxD1）
//            P1.2------接受端（RxD2）
//            P1.3------发送端（TxD2）
//            程序中采用T1定时器
//--------------------------------------------------------------------------------------------------
//  输入参量：无
//  输出参量：无
//==================================================================================================
#define UART_CLOCK 12000000L
void UART_Init(unsigned long Baud)
{
    unsigned char BRT;
	// 基本寄存器配置
    PCON &= 0x7F;        // 波特率不倍速
    SCON |= 0x50;        // 8位数据,可变波特率

    // 波特率产生器选择	
    AUXR |= 0x15;       // 独立波特率发生器时钟为系统频率，即1T，不分频
    BRT = 256-(unsigned char)(UART_CLOCK/Baud/32+0.5);
}

//==================================================================================================
//  函数功能：UART 发送字符
//  函数标记：应用函数，完成
//  函数说明：
//--------------------------------------------------------------------------------------------------
//  输入参量：_CHAR - 待发送字节；取值范围 - ASCII字符
//  输出参量：无
//==================================================================================================
void UART_SendChar(unsigned char _CHAR)
{
	SBUF=_CHAR;
	while(!TI);
	TI=0;
}

//==================================================================================================
//  函数功能：UART 发送字符串
//  函数标记：应用函数，完成
//  函数说明：无
//--------------------------------------------------------------------------------------------------
//  输入参量：_STRG - 待发送字符串；取值范围 - ASCII字符
//  输出参量：无
//==================================================================================================
void UART_SendStrg(unsigned char *_STRG)
{
	while(*_STRG)			// \0 表示字符串结束标志，通过检测是否字符串末尾
	{
		UART_SendChar(*_STRG);
		_STRG++;
	}
}

//==================================================================================================
//  函数功能：UART 发送字符串 回车换行
//  函数标记：应用函数，完成
//  函数说明：无
//--------------------------------------------------------------------------------------------------
//  输入参量：_STRG - 待发送字符串；取值范围 - ASCII字符
//  输出参量：无
//==================================================================================================
void UART_SendStrg_Line(unsigned char *_STRG)
{
	while(*_STRG)			// \0 表示字符串结束标志，通过检测是否字符串末尾
	{
		UART_SendChar(*_STRG);
		_STRG++;
	}

	UART_SendChar(0x0D);		// 换行
	UART_SendChar(0x0A);		// 回车

}

//==================================================================================================
//  函数功能：UART 发送数组
//  函数标记：应用函数，完成
//  函数说明：无
//--------------------------------------------------------------------------------------------------
//  输入参量：_ARRY - 待发送数据指针变量；取值范围 - ASCII字符
//            _Lent - 待发送的数据的长度；取值范围 - 0~255
//  输出参量：无
//==================================================================================================
void UART_SendArry(unsigned char *_ARRY,unsigned char _CUNT)
{
	unsigned char i;		//定义局部变量，用于循环计数
	for(i=0;i<_CUNT;i++)
	{
		UART_SendChar(_ARRY[i]);    
	}
}

