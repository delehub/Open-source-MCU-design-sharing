//==================================================================================================
//  文件功能: HC-SR04-超声波测距传感器模块
//  文件说明: 暂无
//  文件类型: BRD-板载设备驱动文件
//--------------------------------------------------------------------------------------------------
//  硬件平台: STC12C5A60S2
//  软件平台: Keil C51 uVision4
//--------------------------------------------------------------------------------------------------
//  开发组织: 大小林生
//  开发作者: 大小林生
//  官方网站: https://www.daxiaolinsheng.com/
//  官方商城: https://daxiaolinsheng.taobao.com/
//  微信平台: 大小林生
//  版权信息: 文件的内容版权为大小林生拥有，使用时请注明版权出处！
//==================================================================================================

//--------------------------------------------------------------------------------------------------
//  包含的头文件    |   0   |   1   |   2   |   3   |   4   |   5   |   6   |   7   |   8   |   9   
//--------------------------------------------------------------------------------------------------
#include"MAIN.H"                            // 包含全局头文件
#include"HC-SR04.H"                         // 包含外设头文件，HC-SR04-超声波测距传感器模块

//--------------------------------------------------------------------------------------------------
//  宏自定义声明    |   0   |   1   |   2   |   3   |   4   |   5   |   6   |   7   |   8   |   9   
//--------------------------------------------------------------------------------------------------

//--------------------------------------------------------------------------------------------------
//  硬件端口定义    |   0   |   1   |   2   |   3   |   4   |   5   |   6   |   7   |   8   |   9   
//--------------------------------------------------------------------------------------------------
sbit HC_SR04_TRIG=P3^5;                     // 超声波模块 输入端口 用来输入启动信号
sbit HC_SR04_ECHO=P3^6;                     // 超声波模块 输出端口 用来声波信号返回

//--------------------------------------------------------------------------------------------------
//  引用函数声明    |   0   |   1   |   2   |   3   |   4   |   5   |   6   |   7   |   8   |   9   
//--------------------------------------------------------------------------------------------------
unsigned short int  HC_SR04_Distance = 0;   // 超声波模块 测量距离



//==================================================================================================
//  函数功能: HC-SR04 GPIO 初始化 
//  函数标记: 应用函数，完成，
//  函数说明: 
//--------------------------------------------------------------------------------------------------
//  输入参量: 无
//  输出参量: 无
//--------------------------------------------------------------------------------------------------
//  |   -   |   -   |   0   |   1   |   2   |   3   |   4   |   5   |   6   |   7   |   8   |   9   
//==================================================================================================
void HC_SR04_GetValue(void)
{
    unsigned short int TimeCount = 0;
    
    TMOD = TMOD & 0x0F;                             // 定时器设置T1 模式
    TMOD = TMOD | 0x10;
    
    TH1 = 0;                                        // 定时器初值设定为0
    TL1 = 0;                                        // 定时器初值设定为0
    TR1 = 0;
    TF0 = 0;
    ET1 = 0;
    
    HC_SR04_TRIG = 0;                               // 拉低 HC_SR04_TRIG
    
    DELAY_nMS(1);                                   // 延时一段时间
    
    HC_SR04_ECHO = 1;                               // 拉高 HC_SR04_ECHO
    HC_SR04_TRIG = 1;                               // 拉高 HC_SR04_TRIG

    DELAY_nMS(1);                                   // 延时一段时间
    
    HC_SR04_TRIG = 0;                               // 拉低 HC_SR04_TRIG
    
    while(HC_SR04_ECHO == 0);                       // 等待HC_SR04_ECHO低电平
    TR1 = 1;                                        // 定时器0开启
    while(HC_SR04_ECHO == 1)                        // 等待HC_SR04_ECHO高电平
    {
        if(TH1 >= 0x80)                             // 计数超过一定值，视为采集失败
        {
            TR1 = 0;                                // 关闭定时器0中断
            return;
        }
    }
    TR1 = 0;                                        // 关闭定时器0中断
    
    TimeCount= TH1*256 + TL1;                       // 计算出所花时钟数
    
    DELAY_nMS(10);                                  // 防止发射信号对回传信号的影响，进行延时
    
    HC_SR04_Distance = (unsigned long int)TimeCount *17 / 1000;        // 转化为距离，单位CM
}

