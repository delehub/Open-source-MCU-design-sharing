//==================================================================================================
//  文件功能: LCD1602-液晶显示屏
//  文件说明: 暂无
//  文件类型: BRD-板载设备驱动文件
//--------------------------------------------------------------------------------------------------
//  硬件平台: STC89C52RC
//  软件平台: Keil uVision4 C51
//--------------------------------------------------------------------------------------------------
//  开发组织: 大小林生的店铺
//  开发作者: 大小林生
//  官方网站: https://www.daxiaolinsheng.com/
//  官方商城: https://daxiaolinsheng.taobao.com/
//  微信平台: 大小林生的公众号
//  产品链接: 暂无
//  版权信息: 文件的内容版权为大小林生的店拥有，使用时请注明版权出处！
//--------------------------------------------------------------------------------------------------
//  更新时间: 2017-11-10
//  更新内容: 详情见更新日志
//==================================================================================================

//--------------------------------------------------------------------------------------------------
//  包含的头文件    |   0   |   1   |   2   |   3   |   4   |   5   |   6   |   7   |   8   |   9   
//--------------------------------------------------------------------------------------------------
		
#include"MAIN.H"                                   // 包含全局头文件
#include"LCD1602.H"									//LCD1602显示头文件                         
//--------------------------------------------------------------------------------------------------
// 宏自定义声明     |   0   |   1   |   2   |   3   |   4   |   5   |   6   |   7   |   8   |   9   
//--------------------------------------------------------------------------------------------------
//  LCD1602 工作模式
#define LCD1602_MODE_4PIN           0               // LCD1602工作模式 4PIN - 4线制驱动
#define LCD1602_MODE_8PIN           1               // LCD1602工作模式 8PIN - 8线制驱动

#define LCD1602_MODE                LCD1602_MODE_8PIN               // 8线制驱动

//--------------------------------------------------------------------------------------------------
//  LCD1602 功能选择
#define LCD1602_FUNC_GRAM           1               // LCD1602 GRAM功能 0 - 不使用，1 - 使用
//--------------------------------------------------------------------------------------------------
//  LCD1602 指令
#define LCD1602_COMD_CLEAR                  0x01    // 清屏操作指令，光标对位，地址计数器清零

#define LCD1602_COMD_GO_HOME                0x02    // 光标操作指令，AC=0，光标、画面回HOME位

#define LCD1602_COMD_AC_AUTO_INCREMENT      0x06    // AC操作指令，数据读、写操作后，AC自动增一
#define LCD1602_COMD_AC_AUTO_DECREASE       0x04    // AC操作指令，数据读、写操作后，AC自动减一

#define LCD1602_COMD_MOVE_ENABLE            0x05    // 输入方式设置操作指令，输入方式设置操作指令,/数据读、写操作，画面平移
#define LCD1602_COMD_MOVE_DISENABLE         0x04    // 输入方式设置操作指令，数据读、写操作，画面不动

#define LCD1602_COMD_DISPLAY_ON             0x0C    // 显示指令，开启显示
#define LCD1602_COMD_DISPLAY_OFF            0x08    // 显示指令，关闭显示

#define LCD1602_COMD_CURSOR_ON              0x0A    // 光标指令，显示
#define LCD1602_COMD_CURSOR_OFF             0x08    // 光标指令，不显示
#define LCD1602_COMD_CURSOR_BLINK_ON        0x09    // 光标指令，闪烁
#define LCD1602_COMD_CURSOR_BLINK_OFF       0x08    // 光标指令，不闪烁

#define LCD1602_COMD_LEFT_MOVE              0x18    // LCD显示左移一位
#define LCD1602_COMD_RIGHT_MOVE             0x1C    // LCD显示右移一位
#define LCD1602_COMD_CURSOR_LEFT_MOVE       0x10    // 光标左移一位
#define LCD1602_COMD_CURSOR_RIGHT_MOVE      0x14    // 光标右移一位

#define LCD1602_COMD_DISPLAY_DOUBLE_LINE    0x38    // 两行显示
#define LCD1602_COMD_DISPLAY_SINGLE_LINE    0x30    // 单行显示


//--------------------------------------------------------------------------------------------------
// 定义引用变量     |   0   |   1   |   2   |   3   |   4   |   5   |   6   |   7   |   8   |   9   
//--------------------------------------------------------------------------------------------------
#if (LCD1602_FUNC_GRAM == 1)
code unsigned char LCD1602_GRAMChar[] = 
{
    0x10,0x06,0x09,0x08,0x08,0x09,0x06,0x00,        // 字符 ℃ 
    0x04,0x1D,0x14,0x15,0x14,0x1D,0x04,0x00,        // 字符 小喇叭
    0x04,0x0E,0x0A,0x0A,0x1F,0x00,0x15,0x00,        // 字符 闹铃 
};
#endif

//--------------------------------------------------------------------------------------------------
// 硬件端口定义     |   0   |   1   |   2   |   3   |   4   |   5   |   6   |   7   |   8   |   9   
//--------------------------------------------------------------------------------------------------
#if (LCD1602_MODE == LCD1602_MODE_8PIN)

#if 0		   //伟煌
#define LCD1602_DATA_PINS  P0                       // LCD1602 DATA 数据端口，     8位数据端口。
sbit LCD1602_BUSY_PINS = LCD1602_DATA_PINS^7;       // LCD1602 BUSY 忙信号位，     当BUSY=0时，空闲，  当BUSY=1时，忙碌。 
sbit LCD1602_EN_PINS = P2^3;                        // LCD1602 EN   使能信号，     下降沿触发操作。
sbit LCD1602_RW_PINS = P2^4;                        // LCD1602 RW   读写控制，     当RW=0时，写入信息，当RW=1时，读取信息。
sbit LCD1602_RS_PINS = P2^5;						// LCD1602 RS   数据/指令选择，当RS=0时，指令操作，当RS=1时，数据操作。
#endif

#if 1		   // 普中
#define LCD1602_DATA_PINS  P0                       // LCD1602 DATA 数据端口，     8位数据端口。
sbit LCD1602_BUSY_PINS = LCD1602_DATA_PINS^7;       // LCD1602 BUSY 忙信号位，     当BUSY=0时，空闲，  当BUSY=1时，忙碌。 
sbit LCD1602_EN_PINS = P2^7;                        // LCD1602 EN   使能信号，     下降沿触发操作。
sbit LCD1602_RW_PINS = P2^5;                        // LCD1602 RW   读写控制，     当RW=0时，写入信息，当RW=1时，读取信息。
sbit LCD1602_RS_PINS = P2^6;						// LCD1602 RS   数据/指令选择，当RS=0时，指令操作，当RS=1时，数据操作。
#endif			 


                        
#endif

//--------------------------------------------------------------------------------------------------
#if (LCD1602_MODE == LCD1602_MODE_4PIN)

#endif
//-- -- -- -- -- -- -- -- -- -- -- -- -- -- -- -- -- -- -- -- -- -- -- -- -- -- -- -- -- -- -- -- -- 
#define LCD1602_DATA_OUPT_D(X)      LCD1602_DATA_PINS = X                   // LCD1602_DATA 输出电平 数据0/1
#define LCD1602_DATA_INPT_D                                                 // LCD1602_DATA 输入电平 数据0/1

#define LCD1602_DATA_DIRT_O                                                 // LCD1602_DATA 输出方向
#define LCD1602_DATA_DIRT_I                                                 // LCD1602_DATA 输入方向

#define LCD1602_DATA_REST_U                                                 // LCD1602_DATA 上拉电阻
#define LCD1602_DATA_REST_D                                                 // LCD1602_DATA 下拉电阻


#define LCD1602_EN_OUPT_L           LCD1602_EN_PINS = 0                     // LCD1602_EN 输出低电平 数字0
#define LCD1602_EN_OUPT_H           LCD1602_EN_PINS = 1                     // LCD1602_EN 输出高电平 数字1
#define LCD1602_EN_OUPT_T           LCD1602_EN_PINS =~LCD1602_EN_PINS       // LCD1602_EN 输出翻转电平 数字0/1
#define LCD1602_EN_INPT_D                                                   // LCD1602_EN 输入电平 数据0/1

#define LCD1602_EN_DIRT_O                                                   // LCD1602_EN 输出方向
#define LCD1602_EN_DIRT_I                                                   // LCD1602_EN 输入方向

#define LCD1602_EN_REST_U                                                   // LCD1602_EN 上拉电阻
#define LCD1602_EN_REST_D                                                   // LCD1602_EN 下拉电阻

#define LCD1602_RW_OUPT_L           LCD1602_RW_PINS = 0                     // LCD1602_RW 输出低电平 数字0
#define LCD1602_RW_OUPT_H           LCD1602_RW_PINS = 1                     // LCD1602_RW 输出高电平 数字1
#define LCD1602_RW_OUPT_T           LCD1602_RW_PINS =~LCD1602_RW_PINS       // LCD1602_RW 输出翻转电平 数字0/1
#define LCD1602_RW_INPT_D                                                   // LCD1602_RW 输入电平 数据0/1

#define LCD1602_RW_DIRT_O                                                   // LCD1602_RW 输出方向
#define LCD1602_RW_DIRT_I                                                   // LCD1602_RW 输入方向

#define LCD1602_RW_REST_U                                                   // LCD1602_RW 上拉电阻
#define LCD1602_RW_REST_D                                                   // LCD1602_RW 下拉电阻


#define LCD1602_RS_OUPT_L           LCD1602_RS_PINS = 0                     // LCD1602_RS 输出低电平 数字0
#define LCD1602_RS_OUPT_H           LCD1602_RS_PINS = 1                     // LCD1602_RS 输出高电平 数字1
#define LCD1602_RS_OUPT_T           LCD1602_RS_PINS =~LCD1602_RS_PINS       // LCD1602_RS 输出翻转电平 数字0/1
#define LCD1602_RS_INPT_D                                                   // LCD1602_RS 输入电平 数据0/1

#define LCD1602_RS_DIRT_O                                                   // LCD1602_RS 输出方向
#define LCD1602_RS_DIRT_I                                                   // LCD1602_RS 输入方向

#define LCD1602_RS_REST_U                                                   // LCD1602_RS 上拉电阻
#define LCD1602_RS_REST_D                                                   // LCD1602_RS 下拉电阻

//--------------------------------------------------------------------------------------------------
//  引用函数声明    |   0   |   1   |   2   |   3   |   4   |   5   |   6   |   7   |   8   |   9   
//--------------------------------------------------------------------------------------------------
static void LCD1602_GPIO_Init(void);
void LCD1602_Init(void);
static void LCD1602_WriteCommand(unsigned char _COMD);
static void LCD1602_WriteData(unsigned char _DATA);
void LCD1602_WriteData_GRAM(void);
void LCD1602_Clear(void);

void LCD1602_ShowChar(unsigned char X,unsigned char Y,unsigned char Char);
void LCD1602_ShowString(unsigned char X,unsigned char Y,unsigned char *String);
void LCD1602_ShowArray(unsigned char X,unsigned char Y,unsigned char *Array,unsigned char Count);

void LCD1602_ShowNumber_Integer(unsigned char X,unsigned char Y,int IntegerNumber,unsigned char Count);
void LCD1602_ShowNumber_Float(unsigned char X,unsigned char Y,float FloatNumber,unsigned char Count1,unsigned char Count2);
void LCD1602_ShowNumber_Binary(unsigned char X,unsigned char Y,unsigned int BinaryNumber,unsigned char Count);


//==================================================================================================
//  函数功能: LCD1602 GPIO 初始化 
//  函数标记: 外设驱动函数
//  函数说明: 
//--------------------------------------------------------------------------------------------------
//  输入参量: 无
//  输出参量: 无
//--------------------------------------------------------------------------------------------------
//  |   -   |   -   |   0   |   1   |   2   |   3   |   4   |   5   |   6   |   7   |   8   |   9   
//==================================================================================================
static void LCD1602_GPIO_Init(void)
{
    #if (LCD1602_MODE == LCD1602_MODE_4PIN)
    {
        LCD1602_EN_OUPT_L;
        LCD1602_RW_OUPT_L;
        LCD1602_RS_OUPT_L;
    }
    #endif
    
    #if (LCD1602_MODE == LCD1602_MODE_8PIN)
    {
        LCD1602_EN_OUPT_L;
        LCD1602_RW_OUPT_L;
        LCD1602_RS_OUPT_L;
    }
    #endif
}

//==================================================================================================
//  函数功能: LCD1602 初始化
//  函数标记: 外设驱动函数
//  函数说明: 无
//--------------------------------------------------------------------------------------------------
//  输入参量: 无
//  输出参量: 无
//--------------------------------------------------------------------------------------------------
//  |   -   |   -   |   0   |   1   |   2   |   3   |   4   |   5   |   6   |   7   |   8   |   9   
//==================================================================================================
void LCD1602_Init(void)
{
    //----------------------------------------------------------------------------------------------
    // 端口引脚初始化
    //----------------------------------------------------------------------------------------------
    LCD1602_GPIO_Init();

    //----------------------------------------------------------------------------------------------
    // 功能方面初始化
    //----------------------------------------------------------------------------------------------
    #if (LCD1602_MODE == LCD1602_MODE_4PIN)
    {
        LCD1602_WriteCommand(0x32);                    // 将8位总线转为4位总线
        LCD1602_WriteCommand(0x28);                    // 在四位线下的初始化
        LCD1602_WriteCommand(0x0c);                    // 开显示不显示光标
        LCD1602_WriteCommand(0x06);                    // 写一个指针加1
        LCD1602_WriteCommand(0x01);                    // 清屏
        LCD1602_WriteCommand(0x80);                    // 设置数据指针起点
    }
    #endif

    #if (LCD1602_MODE == LCD1602_MODE_8PIN)
    {
        LCD1602_WriteCommand(0x38);
        LCD1602_WriteCommand(0x0C);
        LCD1602_WriteCommand(0x06);
        LCD1602_WriteCommand(0x01);
        LCD1602_Clear();
    }
    #endif

    // 使用GRAM功能，即使用自定义字符功能，
    #if (LCD1602_FUNC_GRAM == 1)
    {
        LCD1602_WriteData_GRAM();
    }
    #endif
}

//==================================================================================================
//  函数功能: LCD1602 处理忙碌状态
//  函数标记: 外设驱动函数
//  函数说明: 使用条件编译，判断LCD1602控制引脚
//--------------------------------------------------------------------------------------------------
//  输入参量: 无
//  输出参量: 无
//--------------------------------------------------------------------------------------------------
//  |   -   |   -   |   0   |   1   |   2   |   3   |   4   |   5   |   6   |   7   |   8   |   9   
//==================================================================================================
void LCD1602_DealBusy(void)
{
    #if (LCD1602_MODE == LCD1602_MODE_4PIN)
     DELAY_nMS(10);
    #endif
    
    #if (LCD1602_MODE == LCD1602_MODE_8PIN)
    while(1)
    {
        LCD1602_EN_OUPT_L;
        LCD1602_RS_OUPT_L;
        LCD1602_RW_OUPT_H;
        LCD1602_DATA_OUPT_D(0xFF);
        LCD1602_EN_OUPT_H;
        if(!LCD1602_BUSY_PINS)break;
    }
    LCD1602_EN_OUPT_L;
    #endif
}
//==================================================================================================
//  实现功能: LCD1602 写入控制指令
//  函数标记: 外设驱动函数
//  函数说明: 使用条件编译，判断LCD1602控制引脚
//--------------------------------------------------------------------------------------------------
//  输入参量: _COMD - 待写指令，详细命令见宏定义；
//  输出参量: 无
//--------------------------------------------------------------------------------------------------
//  |   -   |   -   |   0   |   1   |   2   |   3   |   4   |   5   |   6   |   7   |   8   |   9   
//==================================================================================================
static void LCD1602_WriteCommand(unsigned char _COMD)
{
    #if (LCD1602_MODE == LCD1602_MODE_4PIN)
    {
        LCD1602_DealBusy();                         // 处忙
        LCD1602_RS_OUPT_L;                          // 指令
        LCD1602_RW_OUPT_L;                          // 写入
    
        LCD1602_DATA=_COMD;                         // 写入指令，高4位指令
        
        LCD1602_EN_OUPT_H;                          // 下降沿写入
        LCD1602_EN_OUPT_L;

        LCD1602_DATA=_COMD<<4;                      // 写入指令,低4位指令
        
        LCD1602_EN_OUPT_H;                          // 下降沿写入
        LCD1602_EN_OUPT_L;
    }
    #endif

    #if (LCD1602_MODE == LCD1602_MODE_8PIN)
    {
        LCD1602_DealBusy();                         // 处忙
        LCD1602_RS_OUPT_L;                          // 指令
        LCD1602_RW_OUPT_L;                          // 写入
        
        LCD1602_DATA_OUPT_D(_COMD);                 // 写入指令，8位指令
        LCD1602_EN_OUPT_H;                          // 下降沿写入
        LCD1602_EN_OUPT_L;
    }
    #endif
}

//==================================================================================================
//  实现功能: LCD1602 写入显示数据
//  函数标记: 外设驱动函数
//  函数说明: 使用条件编译，判断LCD1602控制引脚
//--------------------------------------------------------------------------------------------------
//  输入参量: _DATA - 待写数据；
//  输出参量: 无
//--------------------------------------------------------------------------------------------------
//  |   -   |   -   |   0   |   1   |   2   |   3   |   4   |   5   |   6   |   7   |   8   |   9   
//==================================================================================================
static void LCD1602_WriteData(unsigned char _DATA)
{
    #if (LCD1602_MODE == LCD1602_MODE_4PIN)
    {
        LCD1602_DealBusy();                         // 处忙
        LCD1602_RS_OUPT_H;                          // 数据
        LCD1602_RW_OUPT_L;                          // 写入
    
        LCD1602_DATA=_DATA;                         // 写入数据，高4位数据
        
        LCD1602_EN_OUPT_H;                          // 下降沿写入
        LCD1602_EN_OUPT_L;
    
        LCD1602_DATA=_DATA<<4;                      // 写入数据,低4位数据
        
        LCD1602_EN_OUPT_H;                          // 下降沿写入
        LCD1602_EN_OUPT_L;
    }
    #endif
    
    #if (LCD1602_MODE == LCD1602_MODE_8PIN)
    {
        LCD1602_DealBusy();                         // 处忙
        LCD1602_RS_OUPT_H;                          // 数据
        LCD1602_RW_OUPT_L;                          // 写入
        
        LCD1602_DATA_OUPT_D(_DATA);                 // 写入数据
        LCD1602_EN_OUPT_H;                          // 下降沿写入8位数据
        LCD1602_EN_OUPT_L;
    }
    #endif
}

//==================================================================================================
//  函数功能: LCD1602 写入显示数据 GRAM
//  函数标记: 外设驱动函数
//  函数说明: 无
//--------------------------------------------------------------------------------------------------
//  输入参量: 无
//  输出参量: 无
//--------------------------------------------------------------------------------------------------
//  |   -   |   -   |   0   |   1   |   2   |   3   |   4   |   5   |   6   |   7   |   8   |   9   
//==================================================================================================
#if (LCD1602_FUNC_GRAM == 1)
void LCD1602_WriteData_GRAM(void)
{
    unsigned char i;
    LCD1602_WriteCommand(0x40);
    for(i = 0; i<(sizeof(LCD1602_GRAMChar)/sizeof(LCD1602_GRAMChar[0])); i++)
    {
        LCD1602_WriteData(LCD1602_GRAMChar[i]);
    }
}
#endif

//==================================================================================================
//  实现功能: LCD1602 定位光标
//  函数标记: 外设驱动函数
//  函数说明: 无
//--------------------------------------------------------------------------------------------------
//  输入参量: X - X方向坐标 取值范围 - 0~15
//            Y - Y方向坐标 取值范围 - 0~ 1
//  输出参量: 无
//--------------------------------------------------------------------------------------------------
//  |   -   |   -   |   0   |   1   |   2   |   3   |   4   |   5   |   6   |   7   |   8   |   9   
//==================================================================================================
void LCD1602_SetArea(unsigned char X,unsigned char Y)
{
    switch(Y)
    {
        case 0: LCD1602_WriteCommand(0x80 + X); break;
        case 1: LCD1602_WriteCommand(0xC0 + X); break;
        default:break;
    }
}

//==================================================================================================
//  实现功能: LCD1602 清除屏幕内容
//  函数标记: 外设驱动函数
//  函数说明: LCD1602在执行清屏函数之后，需要等待一段时间执行该过程。
//--------------------------------------------------------------------------------------------------
//  输入参量: 无
//  输出参量: 无
//--------------------------------------------------------------------------------------------------
//  |   -   |   -   |   0   |   1   |   2   |   3   |   4   |   5   |   6   |   7   |   8   |   9   
//==================================================================================================
void LCD1602_Clear(void)
{
    LCD1602_WriteCommand(LCD1602_COMD_CLEAR);
    DELAY_nMS(20);
}

//==================================================================================================
//  实现功能: LCD1602 指定位置 显示字符
//  函数标记: 外设驱动函数
//  函数说明: 无
//--------------------------------------------------------------------------------------------------
//  输入参量: X    - 横坐标 X   取值范围 - 0~15
//            Y    - 纵坐标 Y   取值范围 - 0~ 1
//            Char - 待显示字符 取值范围 - ASCII字符
//  输出参量: 无
//--------------------------------------------------------------------------------------------------
//  |   -   |   -   |   0   |   1   |   2   |   3   |   4   |   5   |   6   |   7   |   8   |   9   
//==================================================================================================
void LCD1602_ShowChar(unsigned char X,unsigned char Y,unsigned char Char)
{
    LCD1602_SetArea(X,Y);                           // 设置显示坐标
    LCD1602_WriteData(Char);                        // 显示指定字符
}

//==================================================================================================
//  实现功能: LCD1602 指定位置 显示字符串
//  函数标记: 外设驱动函数
//  函数说明: 无
//--------------------------------------------------------------------------------------------------
//  输入参量: X    - 横坐标 X       取值范围 - 0~15
//            Y    - 纵坐标 Y       取值范围 - 0~ 1
//            String - 待显示字符串 取值范围 - ASCII字符 字符串长度尽量小于16
//  输出参量: 无
//--------------------------------------------------------------------------------------------------
//  |   -   |   -   |   0   |   1   |   2   |   3   |   4   |   5   |   6   |   7   |   8   |   9   
//==================================================================================================
void LCD1602_ShowString(unsigned char X,unsigned char Y,unsigned char *String)
{            
    LCD1602_SetArea(X,Y);                           // 设置显示坐标
    while(*String)
    {
        LCD1602_WriteData(*String);
        String++;
    }
}

//==================================================================================================
//  实现功能: LCD1602 指定位置 显示数组
//  函数标记: 外设驱动函数
//  函数说明: 数组中的内容需要为可显示字符
//--------------------------------------------------------------------------------------------------
//  输入参量: X     - 横坐标 X   取值范围 - 0~15
//            Y     - 纵坐标 Y   取值范围 - 0~ 1
//            Array - 待显示数组 取值范围 - ASCII字符，字符串长度尽量小于16
//            Count - 待显示长度 取值范围 - 0~16
//  输出参量: 无
//--------------------------------------------------------------------------------------------------
//  |   -   |   -   |   0   |   1   |   2   |   3   |   4   |   5   |   6   |   7   |   8   |   9   
//==================================================================================================
void LCD1602_ShowArray(unsigned char X,unsigned char Y,unsigned char *Array,unsigned char Count)
{
    unsigned char i;                                // 定义局部变量，用于函数循环计数
    LCD1602_SetArea(X,Y);                           // 设置显示坐标

    for(i=0; i<Count; i++)
    {
        LCD1602_WriteData(Array[i]);
    }
}

//==================================================================================================
//  实现功能: LCD1602 指定位置 显示整形数字
//  函数标记: 外设驱动函数
//  函数说明: 最大显示5位数字，位置选取不恰当，可能造成数字显示不完全
//--------------------------------------------------------------------------------------------------
//  输入参量: X     - 横坐标 X   取值范围 - 0~15
//            Y     - 纵坐标 Y   取值范围 - 0~ 1
//            IntegerNumber - 待显示整型数字 取值范围 - -32767~+32768
//            Count - 待显示整型数字长度     取值范围 - 0~5；
//  输出参量: 无
//--------------------------------------------------------------------------------------------------
//  |   -   |   -   |   0   |   1   |   2   |   3   |   4   |   5   |   6   |   7   |   8   |   9   
//==================================================================================================
void LCD1602_ShowNumber_Integer(unsigned char X,unsigned char Y,int IntegerNumber, unsigned char Count)
{
    unsigned char Number_Integer_Array[5]={0};

    //----------------------------------------------------------------------------------------------
    // 判断 整型数字正负
    //----------------------------------------------------------------------------------------------
    if(IntegerNumber < 0)
    {
        IntegerNumber=0 - IntegerNumber;
        LCD1602_ShowChar(X, Y, '-');
    }
    else
    {
        LCD1602_ShowChar(X, Y, '+');
    }

    //----------------------------------------------------------------------------------------------
    // 限制 显示字符数
    //----------------------------------------------------------------------------------------------
    if(Count > 5)
    {
        Count = 5;
    }

    Number_Integer_Array[0] = (IntegerNumber / 10000) % 10 + 0x30;
    Number_Integer_Array[1] = (IntegerNumber / 1000 ) % 10 + 0x30;
    Number_Integer_Array[2] = (IntegerNumber / 100  ) % 10 + 0x30;
    Number_Integer_Array[3] = (IntegerNumber / 10   ) % 10 + 0x30;
    Number_Integer_Array[4] = (IntegerNumber / 1    ) % 10 + 0x30;

    LCD1602_ShowArray(X+1,Y,&(Number_Integer_Array+(5-Count)),Count);
}

//==================================================================================================
//  实现功能: LCD1602 指定位置 显示06x08大小的浮点数字
//  函数标记: 外设驱动函数
//  函数说明: float型数据 有效数字7，double型数据 有效数字16。
//--------------------------------------------------------------------------------------------------
//  输入参量: X     - 横坐标 X   取值范围 - 0~15
//            Y     - 纵坐标 Y   取值范围 - 0~ 1
//            FloatNumber - 待显示浮点型数字  取值范围 - -99999.99999~99999.99999
//            Count1 - 整数显示位数  取值范围 - 0~5
//            Count2 - 小数显示位数  取值范围 - 0~5
//  输出参量: 无
//--------------------------------------------------------------------------------------------------
//  |   -   |   -   |   0   |   1   |   2   |   3   |   4   |   5   |   6   |   7   |   8   |   9   
//==================================================================================================
void LCD1602_ShowNumber_Float(unsigned char X,unsigned char Y,float FloatNumber,unsigned char Count1,unsigned char Count2)
{
    unsigned char Number_Integer_Array[5];          // 定义局部数组，用于存储整数位各位数据
    unsigned char Number_Decimal_Array[5];          // 定义局部数组，用于存储小数位各位数据

    unsigned int  Number_Integer = 0;             // 定义局部变量，表示浮点数的 整数部分
    unsigned int  Number_Decimal = 0;             // 定义局部变量，表示浮点数的 小数部分

    if(FloatNumber < 0)
    {
        FloatNumber= 0 - FloatNumber;
        LCD1602_ShowChar(X,Y,'-');
    }
    else
    {
        LCD1602_ShowChar(X,Y,'+');
    }

    //----------------------------------------------------------------------------------------------
    // 限制 显示字符数
    //----------------------------------------------------------------------------------------------
    // 由于由于float型的有效十进制数值最多为7位，即整数位 + 小数位 数量一定小于等于7
    while((Count1 + Count2 > 7 ) && ( Count1 >= 0 ) && ( Count2 >= 0))
    {
        if(Count1 > 5)
        {
            --Count1;
        }
        else
        {
            --Count2;
        }
    }

    Number_Integer = (unsigned int)(FloatNumber);                                         // 取整数部分
    Number_Decimal = (unsigned short)((FloatNumber - Number_Integer + 0.000005) * 1e5);     // 取小数部分，1e5科学计数法

    Number_Integer_Array[0] = Number_Integer/10000 % 10 + 0x30;     // 计算整数部分
    Number_Integer_Array[1] = Number_Integer/ 1000 % 10 + 0x30;
    Number_Integer_Array[2] = Number_Integer/  100 % 10 + 0x30;
    Number_Integer_Array[3] = Number_Integer/   10 % 10 + 0x30;
    Number_Integer_Array[4] = Number_Integer/    1 % 10 + 0x30;

    Number_Decimal_Array[0] = Number_Decimal/10000 % 10 + 0x30;     // 计算小数部分
    Number_Decimal_Array[1] = Number_Decimal/ 1000 % 10 + 0x30;
    Number_Decimal_Array[2] = Number_Decimal/  100 % 10 + 0x30;
    Number_Decimal_Array[3] = Number_Decimal/   10 % 10 + 0x30;
    Number_Decimal_Array[4] = Number_Decimal/    1 % 10 + 0x30;

    LCD1602_ShowArray(X+1,       Y,&(Number_Integer_Array+(5-Count1)),Count1);      // 显示整数位
    LCD1602_ShowChar( X+1+Count1,Y,'.');
    LCD1602_ShowArray(X+2+Count1,Y,&(Number_Decimal_Array),           Count2);      // 显示小数位
}

//==================================================================================================
//  实现功能: LCD1602 指定位置 显示06x08大小的二进制数字
//  函数标记: 外设驱动函数
//  函数说明: 1. 位置选取不恰当，可能造成字符串显示不完全
//            2. 显示8位二进制数字，主要作为寄存器数据显示
//--------------------------------------------------------------------------------------------------
//  输入参量: X     - 横坐标 X   取值范围 - 0~15
//            Y     - 纵坐标 Y   取值范围 - 0~ 1
//            BinaryNumber - 待显示二进制数字  取值范围 - 0~65535
//            Count - 二进制显示位数  取值范围 - 1~16
//  输出参量: 无
//--------------------------------------------------------------------------------------------------
//  |   -   |   -   |   0   |   1   |   2   |   3   |   4   |   5   |   6   |   7   |   8   |   9   
//==================================================================================================
void LCD1602_ShowNumber_Binary(unsigned char X,unsigned char Y,unsigned int BinaryNumber,unsigned char Count)
{
    unsigned char i;                                // 定义局部变量，用于函数循环计数

    for(i=Count;i>0;i--)
    {
        if(BinaryNumber & ( 1 << (Count-1) ))
        {
            LCD1602_ShowChar(X++, Y, '1');          // 显示二进制字符'1'
        }
        else
        {
            LCD1602_ShowChar(X++, Y, '0');          // 显示二进制字符'1'
        }
        BinaryNumber<<=1;                           // 移位运算
    }
}